## arch/arm64/hotplug/Kconfig
```kconfig
config BRICKED_HOTPLUG
	   bool "Enable kernel based mpdecision"
	   depends on MSM_RUN_QUEUE_STATS
	   default y
	   help
		 This enables kernel based multi core control.

config ALUCARD_HOTPLUG
	bool "Enable alucard-hotplug cpu hotplug driver"
	default n
	help
	Generic Alucard-hotplug cpu hotplug driver for ARM SOCs

config INTELLI_HOTPLUG
        bool "Enable intelli-hotplug cpu hotplug driver"
        default n
        help
          Generic Intelli-plug cpu hotplug driver for ARM SOCs
```
